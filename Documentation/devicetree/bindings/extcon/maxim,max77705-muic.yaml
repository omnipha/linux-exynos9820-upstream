## Documentation/devicetree/bindings/extcon/maxim,max77705-muic.yaml
```yaml
# SPDX-License-Identifier: (GPL-2.0-only OR BSD-2-Clause)
%YAML 1.2
---
$id: http://devicetree.org/schemas/extcon/maxim,max77705-muic.yaml#
$schema: http://devicetree.org/meta-schemas/core.yaml#

title: Maxim MAX77705 companion PMIC Type-C CCIC / MUIC

maintainers:
  - Gregor Sprint <gregor@sprintcx.de>

description:
  The Maxim MAX77705 includes an internal Type-C CC logic and micro-USB
  interface controller (CCIC / MUIC). The CCIC firmware monitors the Type-C
  Configuration Channel and reports cable state. The internal MUIC switch
  routes D+/D- lines between the Type-C receptacle and the USB controller.

properties:
  compatible:
    const: maxim,max77705-muic

  reg:
    maxItems: 1
    description: I2C slave address of the CCIC block, typically 0x25.

required:
  - compatible
  - reg

additionalProperties: false

examples:
  - |
    i2c {
        #address-cells = <1>;
        #size-cells = <0>;

        typec@25 {
            compatible = "maxim,max77705-muic";
            reg = <0x25>;
        };
    };
```

## Documentation/devicetree/bindings/leds/backlight/samsung,s6e3ha9-beyond2-aor-backlight.yaml
```yaml
# SPDX-License-Identifier: (GPL-2.0-only OR BSD-2-Clause)
%YAML 1.2
---
$id: http://devicetree.org/schemas/leds/backlight/samsung,s6e3ha9-beyond2-aor-backlight.yaml#
$schema: http://devicetree.org/meta-schemas/core.yaml#

title: Samsung S6E3HA9 beyond2 provisional AOR backlight

maintainers:
  - Gregor Sprint <gregor@sprintcx.de>

description:
  Board-specific backlight for the Galaxy S10+ S6E3HA9 beyond2 A3 S0 panel.
  The node exposes the existing DSIM0 and D-PHY register windows so AOR
  commands can be queued. It does not describe or change the DECON, clocks,
  resets, power domains, or framebuffer.

properties:
  compatible:
    const: samsung,s6e3ha9-beyond2-aor-backlight

  reg:
    maxItems: 2

  reg-names:
    items:
      - const: dsim
      - const: dphy

  samsung,pmu-syscon:
    $ref: /schemas/types.yaml#/definitions/phandle
    description:
      PMU syscon used to confirm that the display power domain is on before
      every display-controller register access.

required:
  - compatible
  - reg
  - reg-names
  - samsung,pmu-syscon

additionalProperties: false

examples:
  - |
    pmu: system-controller@15860000 {
        compatible = "samsung,exynos9820-pmu", "syscon";
        reg = <0x15860000 0x10000>;
    };

    backlight@19080000 {
        compatible = "samsung,s6e3ha9-beyond2-aor-backlight";
        reg = <0x19080000 0x300>, <0x19161000 0x800>;
        reg-names = "dsim", "dphy";
        samsung,pmu-syscon = <&pmu>;
    };
```

## Documentation/devicetree/bindings/pci/samsung,exynos9820-pcie.yaml
```yaml
# SPDX-License-Identifier: (GPL-2.0-only OR BSD-2-Clause)
%YAML 1.2
---
$id: http://devicetree.org/schemas/pci/samsung,exynos9820-pcie.yaml#
$schema: http://devicetree.org/meta-schemas/core.yaml#

title: Samsung Exynos 9820 PCIe host controller

maintainers:
  - Krzysztof Kozlowski <krzk@kernel.org>

description: |
  The Gen2 PCIe root complex of the Samsung Exynos 9820 SoC, based on the
  Synopsys DesignWare PCIe IP. The PHY and PCS register spaces are managed
  by the controller driver, so they are mapped as reg regions of this node
  rather than through a separate PHY provider.

allOf:
  - $ref: /schemas/pci/pci-host-bridge.yaml#

properties:
  compatible:
    const: samsung,exynos9820-pcie

  reg:
    items:
      - description: Data Bus Interface (DBI) registers.
      - description: External Local Bus interface (ELBI) registers.
      - description: PHY registers.
      - description: PCS registers.
      - description: PCIe configuration space region.

  reg-names:
    items:
      - const: dbi
      - const: elbi
      - const: phy
      - const: pcs
      - const: config

  interrupts:
    maxItems: 1

  clocks:
    items:
      - description: PHY reference clock input.
      - description: DBI AXI clock.
      - description: PHY IEEE1500 wrapper SCL APB clock.
      - description: master AXI clock.
      - description: sub-control instance driver APB clock.
      - description: PCS PIPE2 digital wrapper APB clock.
      - description: slave AXI clock.
      - description: address translation block clock.

  clock-names:
    items:
      - const: ref
      - const: dbi
      - const: phy-apb
      - const: master
      - const: ctrl-apb
      - const: pcs-apb
      - const: slave
      - const: ia

  samsung,pmu-syscon:
    $ref: /schemas/types.yaml#/definitions/phandle
    description:
      Phandle to the PMU system controller, for the PCIe PHY isolation
      control register.

  samsung,sysreg:
    $ref: /schemas/types.yaml#/definitions/phandle
    description:
      Phandle to the FSYS1 system registry, for the PCIe PHY control
      registers.

  reset-gpios:
    description:
      GPIO controlling the PERST# signal of the PCIe bus. Must be active-low.
    maxItems: 1

  vpcie-supply:
    description:
      Regulator powering the external PCIe device, asserted before the
      link is brought up.

  num-lanes:
    const: 1

  max-link-speed:
    const: 1

required:
  - compatible
  - reg
  - reg-names
  - interrupts
  - "#address-cells"
  - "#size-cells"
  - "#interrupt-cells"
  - interrupt-map
  - interrupt-map-mask
  - ranges
  - bus-range
  - device_type
  - num-lanes
  - max-link-speed
  - clocks
  - clock-names
  - samsung,pmu-syscon
  - samsung,sysreg

unevaluatedProperties: false

examples:
  - |
    #include <dt-bindings/interrupt-controller/arm-gic.h>

    pcie: pcie@13f00000 {
        compatible = "samsung,exynos9820-pcie";
        reg = <0x13f00000 0x1000>,
              <0x13ed0000 0x1000>,
              <0x13ef0000 0x1000>,
              <0x13ee0000 0x200>,
              <0x14ffe000 0x2000>;
        reg-names = "dbi", "elbi", "phy", "pcs", "config";
        #address-cells = <3>;
        #size-cells = <2>;
        device_type = "pci";
        ranges = <0x82000000 0 0x14000000 0x14000000 0 0x00ff0000>;
        bus-range = <0x00 0x01>;
        num-lanes = <1>;
        max-link-speed = <1>;
        interrupts = <GIC_SPI 253 IRQ_TYPE_LEVEL_HIGH>;
        #interrupt-cells = <1>;
        interrupt-map-mask = <0 0 0 0>;
        interrupt-map = <0 0 0 0 &gic GIC_SPI 253 IRQ_TYPE_LEVEL_HIGH>;
        clocks = <&cmu_fsys1 11>, <&cmu_fsys1 23>, <&cmu_fsys1 24>,
                 <&cmu_fsys1 25>, <&cmu_fsys1 26>, <&cmu_fsys1 27>,
                 <&cmu_fsys1 28>, <&cmu_fsys1 29>;
        clock-names = "ref", "dbi", "phy-apb", "master", "ctrl-apb",
                      "pcs-apb", "slave", "ia";
        samsung,pmu-syscon = <&pmu_system_controller>;
        samsung,sysreg = <&sysreg_fsys1>;
    };
...
```
